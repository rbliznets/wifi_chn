## Kconfig.projbuild
```kconfig
menu "Wifi channel"

    config WIFICHN_SYNC_TIME
        depends on LWIP_SNTP_MAX_SERVERS>0
        bool "Enable sync time."
        default y
        help
            Установка системного времени из NTP сервера.

    choice
        prompt "Choose core for the wifi tasks"
        default WIFICHN_TASK1

        config WIFICHN_TASK0
            bool "core 0"

        config WIFICHN_TASK1
            bool "core 1"

    endchoice

    config WIFICHN_OTA
        depends on ESP_HTTP_CLIENT_ENABLE_HTTPS
        bool "Enable HTTPS OTA."
        default y
 
    config WIFICHN_UDP
        bool "Enable UDP channel."
        default n

    config WIFICHN_TCP
        bool "Enable TCP channel."
        default n
                                                       
endmenu
```
